## sdkconfig.defaults
```kconfig
CONFIG_LWIP_IP_FORWARD=y
CONFIG_LWIP_IPV4_NAPT=y
CONFIG_ESP_WIFI_SOFTAP_SAE_SUPPORT=y
CONFIG_COMPILER_OPTIMIZATION_SIZE=y

CONFIG_PM_ENABLE=y
CONFIG_PM_DFS_INIT_AUTO=y
CONFIG_PM_POWER_DOWN_CPU_IN_LIGHT_SLEEP=y
CONFIG_FREERTOS_USE_TICKLESS_IDLE=y
CONFIG_ESP32C3_DEFAULT_CPU_FREQ_80=y
CONFIG_ESP_DEFAULT_CPU_FREQ_MHZ_80=y

CONFIG_ESP_MAIN_TASK_STACK_SIZE=16384
CONFIG_PTHREAD_TASK_STACK_SIZE_DEFAULT=4096

CONFIG_LWIP_IP_REASSEMBLY=y
CONFIG_LWIP_IP_FRAG=y
CONFIG_LWIP_IP_REASS_MAX_PBUFS=32
CONFIG_LWIP_MEM_SIZE=32768
CONFIG_LWIP_TCP_MSS=1440
CONFIG_LWIP_TCP_WND_DEFAULT=14400
CONFIG_LWIP_TCP_SND_BUF_DEFAULT=14400

CONFIG_ESP_WIFI_DYNAMIC_TX_BUFFER_NUM=64
CONFIG_ESP_WIFI_DYNAMIC_RX_BUFFER_NUM=64
CONFIG_ESP_WIFI_DYNAMIC_RX_MGMT_BUF_NUM=10
CONFIG_ESP_WIFI_TX_BA_WIN=16
CONFIG_ESP_WIFI_RX_BA_WIN=16
CONFIG_ESP_WIFI_WPA3_SAE_PWE_BOTH=y
```
